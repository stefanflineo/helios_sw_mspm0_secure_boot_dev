/**
 * @cliArgs --device "MSPM0L111X" --part "Default" --package "LQFP-48(PT)" --product "mspm0_sdk@2.10.00.04"
 * @versions {"tool":"1.26.2+4477"}
 */

/**
 * Import the modules used in this configuration.
 */
const AESADV        = scripting.addModule("/ti/driverlib/AESADV");
const GPIO          = scripting.addModule("/ti/driverlib/GPIO", {}, false);
const GPIO1         = GPIO.addInstance();
const GPIO2         = GPIO.addInstance();
const NONMAIN       = scripting.addModule("/ti/driverlib/NONMAIN");
const SECCONFIG     = scripting.addModule("/ti/driverlib/SECCONFIG");
const ProjectConfig = scripting.addModule("/ti/project_config/ProjectConfig");

/**
 * Write custom configuration values to the imported modules.
 */
AESADV.keySize = "DL_AESADV_KEY_SIZE_256_BIT";

const Board = scripting.addModule("/ti/driverlib/Board", {}, false);

GPIO1.$name                         = "GPIO_LEDS";
GPIO1.associatedPins[0].$name       = "USER_LED_RED";
GPIO1.associatedPins[0].pin.$assign = "PB17";

GPIO2.$name                   = "GPIO_GRP_1";
GPIO2.associatedPins[0].$name = "PIN_1";

NONMAIN.nonmainWarning               = true;
NONMAIN.cscExists                    = true;
NONMAIN.flashBankSwap                = true;
NONMAIN.debugAccessEnable            = "enabledWithPW";
NONMAIN.frMode                       = "enabledWithPW";
NONMAIN.frPW0                        = 0x89C546DB;
NONMAIN.frPW1                        = 0x3B6D7E40;
NONMAIN.frPW2                        = 0x76D63D0C;
NONMAIN.frPW3                        = 0x8D47C036;
NONMAIN.frPW4                        = 0x3F2D28E3;
NONMAIN.frPW5                        = 0x3EB019C6;
NONMAIN.frPW6                        = 0x4C7E28DA;
NONMAIN.frPW7                        = 0xE230755A;
NONMAIN.bslMode                      = false;
NONMAIN.meMode                       = "disabled";
NONMAIN.staticWriteProtectionNonMain = true;
NONMAIN.staticWriteProtectionMainLow = 0xFFFC0000;
NONMAIN.swdPW0                       = 0x56B55F67;
NONMAIN.swdPW1                       = 0xFAF981D2;
NONMAIN.swdPW2                       = 0x74FD54AC;
NONMAIN.swdPW3                       = 0xD3D4DFC3;
NONMAIN.swdPW4                       = 0x5D3BCCE4;
NONMAIN.swdPW5                       = 0xEBD22562;
NONMAIN.swdPW6                       = 0x9153251D;
NONMAIN.swdPW7                       = 0xA96B2636;

SECCONFIG.cscPrereqAck             = true;
SECCONFIG.cscBankSize              = 65536;
SECCONFIG.cscSecretAddress         = 0x4000;
SECCONFIG.cscSecretSize            = 1024;
SECCONFIG.cscLockStorageSize       = 1024;
SECCONFIG.cscAppImageBaseAddr      = 0x4800;
SECCONFIG.unprivVerifyOptions      = ["addECDSAVerify","writeExecuteOnly"];
SECCONFIG.enableRollbackProtection = false;
SECCONFIG.enableIPProtection       = false;
SECCONFIG.enableCMACAcceleration   = false;
SECCONFIG.cscAppImageSize          = 47104;

const SYSCTL = scripting.addModule("/ti/driverlib/SYSCTL", {}, false);

ProjectConfig.genDisable = true;
scripting.suppress("Project Configuration File generation is disabled for this project\\. SysConfig Project Migration is not currently supported for this project\\.", ProjectConfig);

/**
 * Pinmux solution for unlocked pins/peripherals. This ensures that minor changes to the automatic solver in a future
 * version of the tool will not impact the pinmux you originally saw.  These lines can be completely deleted in order to
 * re-solve from scratch.
 */
Board.peripheral.$suggestSolution            = "DEBUGSS";
Board.peripheral.swclkPin.$suggestSolution   = "PA20";
Board.peripheral.swdioPin.$suggestSolution   = "PA19";
GPIO2.associatedPins[0].pin.$suggestSolution = "PA0";
SYSCTL.peripheral.$suggestSolution           = "SYSCTL";
