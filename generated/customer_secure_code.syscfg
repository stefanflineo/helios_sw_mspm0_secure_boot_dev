/**
 * These arguments were used when this file was generated. They will be automatically applied on subsequent loads
 * via the GUI or CLI. Run CLI with '--help' for additional information on how to override these arguments.
 * @cliArgs --device "MSPM0L111X" --part "Default" --package "LQFP-48(PT)" --product "mspm0_sdk@2.10.00.04"
 * @v2CliArgs --device "MSPM0L1117" --package "LQFP-48(PT)" --product "mspm0_sdk@2.10.00.04"
 * @versions {"tool":"1.26.2+4477"}
 */

/**
 * Import the modules used in this configuration.
 */
const AESADV        = scripting.addModule("/ti/driverlib/AESADV");
const GPIO          = scripting.addModule("/ti/driverlib/GPIO", {}, false);
const GPIO1         = GPIO.addInstance();
const GPIO2         = GPIO.addInstance();
const NONMAIN       = scripting.addModule("/ti/driverlib/NONMAIN");
const SECCONFIG     = scripting.addModule("/ti/driverlib/SECCONFIG");
const ProjectConfig = scripting.addModule("/ti/project_config/ProjectConfig");

/**
 * Write custom configuration values to the imported modules.
 */
const Board = scripting.addModule("/ti/driverlib/Board", {}, false);

GPIO1.$name                         = "GPIO_LEDS";
GPIO1.associatedPins[0].$name       = "USER_LED_RED";
GPIO1.associatedPins[0].pin.$assign = "PB17";

GPIO2.$name                   = "GPIO_GRP_1";
GPIO2.associatedPins[0].$name = "PIN_1";

NONMAIN.nonmainWarning = true;
NONMAIN.cscExists      = true;
NONMAIN.flashBankSwap  = true;
NONMAIN.bslMode        = false;

SECCONFIG.cscPrereqAck        = true;
SECCONFIG.developmentOptions  = ["enablePseudoRandom"];
SECCONFIG.cscBankSize         = 65536;
SECCONFIG.cscSecretAddress    = 0x4000;
SECCONFIG.cscSecretSize       = 1024;
SECCONFIG.cscLockStorageSize  = 1024;
SECCONFIG.cscAppImageBaseAddr = 0x4800;
SECCONFIG.cscAppImageSize     = 10240;

const SYSCTL = scripting.addModule("/ti/driverlib/SYSCTL", {}, false);

ProjectConfig.genDisable = true;

/**
 * Pinmux solution for unlocked pins/peripherals. This ensures that minor changes to the automatic solver in a future
 * version of the tool will not impact the pinmux you originally saw.  These lines can be completely deleted in order to
 * re-solve from scratch.
 */
Board.peripheral.$suggestSolution            = "DEBUGSS";
Board.peripheral.swclkPin.$suggestSolution   = "PA20";
Board.peripheral.swdioPin.$suggestSolution   = "PA19";
GPIO2.associatedPins[0].pin.$suggestSolution = "PA0";
SYSCTL.peripheral.$suggestSolution           = "SYSCTL";
